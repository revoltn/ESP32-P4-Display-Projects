/* Main clock screen: big digital time, date, alarm indicator, link
 * indicators, status line, settings cog. The 1 s LVGL timer keeps
 * everything current.
 *
 * Giant face layout (800x480 landscape):
 *
 *   [P]      {date}      [A] [N][AI][MIC][API] [W] [S]  <- 72 px top row
 *
 *          HH :  M        hours: Dangrek 478 px, ~330 px ink (2/3 of the
 *                M        width); minutes stacked tens-over-units in
 *                         Dangrek 226 px, ink-aligned to the hours
 *                  {temporary status}
 *
 * P = play button, A = next alarm (green armed, amber snoozing, red "missed"
 * after an auto-stop until the face is tapped), W = WiFi strength bars,
 * S = settings cog. N/AI/MIC/API are the service indicators (music server,
 * AI server, voice, HTTP control API), each coloured every tick from its
 * module's <mod>_service_state(): grey off, dim unproven, green working, red
 * failed. The two digit fonts are generated by tools/fonts/gen_fonts.sh
 * (digits, '-' and ':' only). */
#include <limits.h>
#include <stdarg.h>
#include <stdio.h>
#include <string.h>
#include <time.h>
#include "esp_log.h"
#include "lvgl.h"
#include "bsp/esp-bsp.h"

#include "app_common.h"
#include "settings.h"
#include "clock_sync.h"
#include "wifi_mgr.h"
#include "navidrome_client.h"
#include "localai_client.h"
#include "voice.h"
#include "api_server.h"
#include "alarm.h"
#include "fonts/app_icons.h"
#include "fonts/app_fonts.h"
#include "ui_clock.h"
#include "ui_settings.h"
#include "ui_play.h"

static const char *TAG = "ui_clock";

#define TIME_COL_DAY        0xE8EDF2   /* == UI_COL_TEXT */
#define TIME_COL_NIGHT      0xC83C00   /* deep red-orange: no blue, low green for night vision */
LV_FONT_DECLARE(dangrek_478);          /* hours (Dangrek, digits only) */
LV_FONT_DECLARE(dangrek_226);          /* minutes + colon */
#define FONT_HH             (&dangrek_478)
#define FONT_MM             (&dangrek_226)
#define GIANT_GAP_X         12         /* hours | colon | minute column spacing */

#define EDGE                10         /* button inset from the screen edge */
#define BTN_SIZE            72         /* round buttons (play, cog) */
#define TOP_ROW_Y           EDGE       /* top row = the 72 px band the buttons sit in */
#define TOP_ROW_MID         (TOP_ROW_Y + BTN_SIZE / 2)
#define GIANT_TOP_CLEAR     (TOP_ROW_Y + BTN_SIZE + 8)   /* digits start below the top row */
#define GIANT_BOTTOM_CLEAR  34         /* room for the status line */

/* Right-hand cluster of the top row, offsets from the right edge. */
#define WIFI_BAR_W          6
#define WIFI_BAR_GAP        3
#define WIFI_BARS           4
#define WIFI_BOX_W          (WIFI_BARS * WIFI_BAR_W + (WIFI_BARS - 1) * WIFI_BAR_GAP)
#define WIFI_BOX_H          28
#define WIFI_X              (-(EDGE + BTN_SIZE + 14))
/* Service indicators sit left of the WiFi bars, laid out right-to-left from
 * SVC_RIGHT by their measured widths (svc_layout): the labels are text, so
 * their widths are font-dependent and not worth hard-coding. */
#define SVC_RIGHT           (WIFI_X - WIFI_BOX_W - 14)
#define SVC_GAP             12
#define SVC_COUNT           4
/* "API" stays a word (the user's call - there is no unambiguous glyph for it).
 * montserrat_20 rather than _16 so its visual weight sits closer to the 28 px
 * icons beside it. */
#define SVC_FONT            (&lv_font_montserrat_20)
/* The alarm text and the date are placed from the cluster's MEASURED extent
 * in ui_clock_apply_face - no hard-coded cluster or alarm width here. */
#define DATE_X              (EDGE + BTN_SIZE + 10)

#define COL_UNLIT           0x2A2F36
#define COL_OK              0x7FD08A
#define COL_BAD             0xD05050
#define COL_IDLE            0x4A4F55
#define COL_WARN            0xE8B04C   /* alarm snoozing (same amber as the web page) */
/* Widest the alarm indicator ever gets ("missed" beats "Wed 00:00"); the
 * Giant face's date field is sized to stop clear of this. */
#define ALARM_TEXT_WIDEST   LV_SYMBOL_BELL "  missed 00:00"

#define STATUS_HOLD_MS      30000      /* status line clears itself after this */
#define RSSI_PERIOD_S       10
#define RSSI_NONE           INT_MIN

static lv_obj_t *s_time_label;          /* Large face: "HH:MM", montserrat_48 scaled */
static lv_obj_t *s_secs_label;
static lv_obj_t *s_hh_label;            /* Giant face: hours */
static lv_obj_t *s_colon_label;         /* Giant face: ':' */
static lv_obj_t *s_m10_label;           /* Giant face: tens of minutes (top) */
static lv_obj_t *s_m1_label;            /* Giant face: units of minutes (bottom) */
static lv_obj_t *s_date_label;
static lv_obj_t *s_alarm_label;
static lv_obj_t *s_status_label;
static lv_obj_t *s_cog;
static lv_obj_t *s_play;
/* Service indicators, left to right as laid out: music server, AI, voice, API.
 * Each is a small label coloured by its module's <mod>_service_state(). */
enum { SVC_MUSIC, SVC_AI, SVC_VOICE, SVC_API };
static lv_obj_t *s_svc[SVC_COUNT];
static lv_obj_t *s_wifi_box;
static lv_obj_t *s_wifi_bar[WIFI_BARS];
static lv_timer_t *s_status_timer;

/* RSSI_NONE = not measured since this connection came up. A failed read keeps
 * the previous value: a stale bar count beats a false "weak" one. */
static volatile int  s_rssi = RSSI_NONE;   /* dBm, written by the worker task */
static volatile bool s_rssi_pending;       /* one read in flight at most */
static bool          s_rssi_was_connected; /* edge detect for the first read */

static void cog_cb(lv_event_t *e)
{
    ui_settings_open();
}

static void play_cb(lv_event_t *e)
{
    ui_play_open();
}

static lv_obj_t *round_button(lv_obj_t *parent, const char *symbol, lv_event_cb_t cb)
{
    lv_obj_t *btn = lv_button_create(parent);
    lv_obj_set_size(btn, BTN_SIZE, BTN_SIZE);
    lv_obj_set_style_bg_color(btn, lv_color_hex(0x181C22), 0);
    lv_obj_set_style_radius(btn, BTN_SIZE / 2, 0);
    lv_obj_add_event_cb(btn, cb, LV_EVENT_CLICKED, NULL);
    lv_obj_t *ic = lv_label_create(btn);
    lv_label_set_text(ic, symbol);
    lv_obj_set_style_text_font(ic, &lv_font_montserrat_28, 0);
    lv_obj_set_style_text_color(ic, lv_color_hex(0x7A828C), 0);
    lv_obj_center(ic);
    return btn;
}

/* y that vertically centres a one-line label of `font` in the top row */
static int32_t top_row_text_y(const lv_font_t *font)
{
    return TOP_ROW_MID - lv_font_get_line_height(font) / 2;
}

/* Where glyph `ch` of `font` puts its ink, in px from the top of a label
 * using that font (LVGL draws a glyph at baseline - box_h - ofs_y). */
static void glyph_ink(const lv_font_t *font, uint32_t ch, int32_t *top, int32_t *bottom)
{
    lv_font_glyph_dsc_t g;
    int32_t baseline = font->line_height - font->base_line;
    if (!lv_font_get_glyph_dsc(font, &g, ch, 0)) {
        *top = 0;
        *bottom = font->line_height;
        return;
    }
    *bottom = baseline - g.ofs_y;
    *top = *bottom - g.box_h;
}

static int32_t text_w(const lv_font_t *font, const char *txt)
{
    lv_point_t sz;
    lv_text_get_size(&sz, txt, font, 0, 0, LV_COORD_MAX, LV_TEXT_FLAG_NONE);
    return sz.x;
}

/* Arrange the widgets for the selected clock face. Caller holds the LVGL
 * lock (create path and the settings dropdown callback both qualify). */
void ui_clock_apply_face(void)
{
    if (s_time_label == NULL) {
        return;
    }
    int32_t hor = lv_display_get_horizontal_resolution(NULL);
    int32_t ver = lv_display_get_vertical_resolution(NULL);

    if (settings_get()->clock_face == CLOCK_FACE_GIANT) {
        /* Giant: one 72 px top row holds play (left), the date (centred in
         * the gap) and alarm / Navidrome / WiFi / cog (right). Below it the
         * hours (native 478 px Dangrek, no scaling) sit left of a
         * colon and a narrow column of stacked minute digits. Everything is
         * positioned from the fonts' real glyph ink so the tens digit's top
         * meets the hours' top and the units digit's bottom meets their
         * bottom, whatever the fonts' internal padding. */
        int32_t hh_top, hh_bot, mm_top, mm_bot, c_top, c_bot;
        glyph_ink(FONT_HH, '0', &hh_top, &hh_bot);
        glyph_ink(FONT_MM, '0', &mm_top, &mm_bot);
        glyph_ink(FONT_MM, ':', &c_top, &c_bot);
        int32_t hh_w = text_w(FONT_HH, "00");
        int32_t mm_w = text_w(FONT_MM, "0");
        int32_t c_w  = text_w(FONT_MM, ":");

        int32_t area_h = ver - GIANT_TOP_CLEAR - GIANT_BOTTOM_CLEAR;
        int32_t ink_h  = hh_bot - hh_top;
        int32_t ink_y  = GIANT_TOP_CLEAR + (area_h - ink_h) / 2;   /* hours ink top */
        int32_t x = (hor - (hh_w + GIANT_GAP_X + c_w + GIANT_GAP_X + mm_w)) / 2;

        /* fixed width = widest pair, right-aligned so the gap to the colon
         * stays constant when a narrow '1' leads */
        lv_obj_set_width(s_hh_label, hh_w);
        lv_obj_align(s_hh_label, LV_ALIGN_TOP_LEFT, x, ink_y - hh_top);
        x += hh_w + GIANT_GAP_X;
        lv_obj_align(s_colon_label, LV_ALIGN_TOP_LEFT, x,
                     ink_y + ink_h / 2 - (c_top + c_bot) / 2);
        x += c_w + GIANT_GAP_X;
        lv_obj_set_width(s_m10_label, mm_w);
        lv_obj_set_width(s_m1_label, mm_w);
        lv_obj_align(s_m10_label, LV_ALIGN_TOP_LEFT, x, ink_y - mm_top);
        lv_obj_align(s_m1_label, LV_ALIGN_TOP_LEFT, x, ink_y + ink_h - mm_bot);

        lv_obj_remove_flag(s_hh_label, LV_OBJ_FLAG_HIDDEN);
        lv_obj_remove_flag(s_colon_label, LV_OBJ_FLAG_HIDDEN);
        lv_obj_remove_flag(s_m10_label, LV_OBJ_FLAG_HIDDEN);
        lv_obj_remove_flag(s_m1_label, LV_OBJ_FLAG_HIDDEN);
        lv_obj_add_flag(s_time_label, LV_OBJ_FLAG_HIDDEN);
        lv_obj_add_flag(s_secs_label, LV_OBJ_FLAG_HIDDEN);

        lv_obj_align(s_play, LV_ALIGN_TOP_LEFT, EDGE, TOP_ROW_Y);
        lv_obj_align(s_cog, LV_ALIGN_TOP_RIGHT, -EDGE, TOP_ROW_Y);

        /* Service cluster first: it is laid out from its labels' measured
         * widths, and the alarm text and the date are then placed against
         * where it actually ended. Nothing here depends on a hard-coded
         * cluster width, so changing a label or a font cannot silently make
         * the top row overlap.
         *
         * Right-to-left from SVC_RIGHT: API, voice, AI, music - so they read
         * left-to-right in dependency order, with the music server (the one
         * that matters most here) furthest from the edge. LV_ALIGN_TOP_RIGHT
         * puts the label's RIGHT edge at the offset, so place at sx first,
         * then step left by this label's own width. */
        int32_t sx = SVC_RIGHT;
        for (int i = SVC_COUNT - 1; i >= 0; i--) {
            const lv_font_t *f = lv_obj_get_style_text_font(s_svc[i], 0);
            lv_obj_remove_flag(s_svc[i], LV_OBJ_FLAG_HIDDEN);
            lv_obj_align(s_svc[i], LV_ALIGN_TOP_RIGHT, sx, top_row_text_y(f));
            sx -= text_w(f, lv_label_get_text(s_svc[i])) + SVC_GAP;
        }
        int32_t alarm_x = sx - 6;   /* sx already includes one trailing gap */

        lv_obj_set_style_text_font(s_alarm_label, &lv_font_montserrat_20, 0);
        lv_obj_align(s_alarm_label, LV_ALIGN_TOP_RIGHT, alarm_x,
                     top_row_text_y(&lv_font_montserrat_20));

        /* Widest the alarm text ever gets, so the date stops clear of it. */
        int32_t alarm_w = text_w(&lv_font_montserrat_20, ALARM_TEXT_WIDEST);
        int32_t date_w = hor - DATE_X - (-alarm_x) - alarm_w - 12;
        lv_obj_set_width(s_date_label, date_w > 0 ? date_w : 0);
        lv_obj_set_style_text_align(s_date_label, LV_TEXT_ALIGN_CENTER, 0);
        lv_obj_align(s_date_label, LV_ALIGN_TOP_LEFT, DATE_X,
                     top_row_text_y(&lv_font_montserrat_20));

        lv_obj_remove_flag(s_wifi_box, LV_OBJ_FLAG_HIDDEN);
        lv_obj_align(s_wifi_box, LV_ALIGN_TOP_RIGHT, WIFI_X,
                     TOP_ROW_MID - WIFI_BOX_H / 2);

        lv_obj_align(s_status_label, LV_ALIGN_BOTTOM_MID, 0, -8);
    } else {
        /* Large (original layout): cog top-right, play bottom-right, no
         * link indicators. */
        lv_obj_set_style_transform_scale(s_time_label, 256 * 3, 0);
        lv_obj_align(s_time_label, LV_ALIGN_CENTER, 0, -120);
        lv_obj_remove_flag(s_time_label, LV_OBJ_FLAG_HIDDEN);
        lv_obj_remove_flag(s_secs_label, LV_OBJ_FLAG_HIDDEN);
        lv_obj_add_flag(s_hh_label, LV_OBJ_FLAG_HIDDEN);
        lv_obj_add_flag(s_colon_label, LV_OBJ_FLAG_HIDDEN);
        lv_obj_add_flag(s_m10_label, LV_OBJ_FLAG_HIDDEN);
        lv_obj_add_flag(s_m1_label, LV_OBJ_FLAG_HIDDEN);
        lv_obj_align(s_secs_label, LV_ALIGN_CENTER, 0, 10);

        lv_obj_align(s_cog, LV_ALIGN_TOP_RIGHT, -EDGE, EDGE);
        lv_obj_align(s_play, LV_ALIGN_BOTTOM_RIGHT, -EDGE, -EDGE);

        lv_obj_set_width(s_date_label, LV_SIZE_CONTENT);
        lv_obj_set_style_text_align(s_date_label, LV_TEXT_ALIGN_CENTER, 0);
        lv_obj_align(s_date_label, LV_ALIGN_CENTER, 0, 80);
        lv_obj_set_style_text_font(s_alarm_label, &lv_font_montserrat_28, 0);
        lv_obj_align(s_alarm_label, LV_ALIGN_CENTER, 0, 150);

        for (int i = 0; i < SVC_COUNT; i++) {
            lv_obj_add_flag(s_svc[i], LV_OBJ_FLAG_HIDDEN);
        }
        lv_obj_add_flag(s_wifi_box, LV_OBJ_FLAG_HIDDEN);

        lv_obj_align(s_status_label, LV_ALIGN_BOTTOM_MID, 0, -14);
    }
}

/* Worker-task job: esp_wifi_sta_get_ap_info is a blocking SDIO RPC to the
 * C6, so it must never run on the LVGL task. On failure (RPC lock busy behind
 * a scan or a connect, driver error) the last reading stands. */
static void rssi_job(void *arg)
{
    wifi_conn_info_t wi;
    if (wifi_mgr_get_info(&wi)) {
        s_rssi = wi.rssi;
    }
    s_rssi_pending = false;
}

static int wifi_bars_lit(bool connected, int rssi)
{
    if (!connected) {
        return 0;
    }
    if (rssi == RSSI_NONE) {
        return 1;      /* connected, strength not measured yet */
    }
    if (rssi >= -55) {
        return 4;
    }
    if (rssi >= -65) {
        return 3;
    }
    if (rssi >= -75) {
        return 2;
    }
    return 1;
}

/* Grey = off/not configured, dim = configured but unproven, up-but-suspended
 * (the mic while a song owns the codec), OR up but not heard from within the
 * server-check window (boot_svc_fresh_window_us: ~2 x svc_poll_s), green =
 * answered within that window, red = configured but the probe or bring-up
 * failed. */
static uint32_t svc_col(svc_state_t s)
{
    switch (s) {
    case SVC_UP:     return COL_OK;
    case SVC_FAIL:   return COL_BAD;
    case SVC_WAIT:
    case SVC_PAUSED: return COL_IDLE;
    case SVC_OFF:
    default:       return COL_UNLIT;
    }
}

static void update_indicators(int tick)
{
    bool connected = wifi_mgr_is_connected();
    if (!connected) {
        s_rssi = RSSI_NONE;
    } else if (!s_rssi_was_connected || tick % RSSI_PERIOD_S == 0) {
        /* One read right after connect, then a flat 10 s cadence. If the
         * previous read is still queued on the worker, skip this tick: its
         * answer will land, and posting another would only stack RPCs
         * behind whatever is holding the C6 link. */
        if (!s_rssi_pending) {
            s_rssi_pending = app_run_async(rssi_job, NULL);
        }
    }
    s_rssi_was_connected = connected;
    /* Lit bars are green, the same green the service indicators use: WiFi is
     * a service like the rest, and the bar COUNT already carries the signal
     * strength. Disconnected leaves lit == 0, so all four go dark. */
    int lit = wifi_bars_lit(connected, s_rssi);
    for (int i = 0; i < WIFI_BARS; i++) {
        lv_obj_set_style_bg_color(s_wifi_bar[i],
                                  lv_color_hex(i < lit ? COL_OK : COL_UNLIT), 0);
    }

    const svc_state_t st[SVC_COUNT] = {
        [SVC_MUSIC] = nav_service_state(),
        [SVC_AI]    = ai_service_state(),
        [SVC_VOICE] = voice_service_state(),
        [SVC_API]   = api_service_state(),
    };
    for (int i = 0; i < SVC_COUNT; i++) {
        lv_obj_set_style_text_color(s_svc[i], lv_color_hex(svc_col(st[i])), 0);
    }
}

/* The date, measured once per day change against the label's width: the
 * full "Wednesday  17 September 2026" only just fits beside the alarm text
 * on the Giant face, so long combinations fall back to "Wed 17 Sep 2026"
 * instead of being dot-truncated. */
static void update_date(const struct tm *tm)
{
    static int last_yday = -1, last_year = -1;
    static int32_t last_w = -1;
    int32_t w = lv_obj_get_width(s_date_label);
    if (tm->tm_yday == last_yday && tm->tm_year == last_year && w == last_w) {
        return;
    }
    last_yday = tm->tm_yday;
    last_year = tm->tm_year;
    last_w = w;
    char date[48];
    strftime(date, sizeof(date), "%A  %d %B %Y", tm);
    const lv_font_t *f = lv_obj_get_style_text_font(s_date_label, 0);
    if (w > 0 && text_w(f, date) > w) {
        strftime(date, sizeof(date), "%a %d %b %Y", tm);
    }
    lv_label_set_text(s_date_label, date);
}

/* Alarm indicator: red "missed" until acknowledged, else the next ring
 * (amber while it is a snooze), else grey off. Reads the scheduler's
 * lock-free snapshot; the label is only touched when the text changes. */
static void update_alarm_label(time_t now)
{
    static char last[40];
    static uint32_t last_col;
    char txt[40];
    uint32_t col;
    alarm_next_t a;
    struct tm tm;

    if (alarm_last_missed(&a)) {
        clock_sync_localtime(&a.at, &tm);
        snprintf(txt, sizeof(txt), LV_SYMBOL_BELL "  missed %02d:%02d",
                 tm.tm_hour, tm.tm_min);
        col = COL_BAD;
    } else if (alarm_next(&a)) {
        clock_sync_localtime(&a.at, &tm);
        if (a.at - now < 86400) {
            snprintf(txt, sizeof(txt), LV_SYMBOL_BELL "  %02d:%02d",
                     tm.tm_hour, tm.tm_min);
        } else {
            char wd[8];
            strftime(wd, sizeof(wd), "%a", &tm);
            snprintf(txt, sizeof(txt), LV_SYMBOL_BELL "  %s %02d:%02d", wd,
                     tm.tm_hour, tm.tm_min);
        }
        col = a.snooze ? COL_WARN : COL_OK;
    } else {
        snprintf(txt, sizeof(txt), LV_SYMBOL_BELL "  off");
        col = COL_IDLE;
    }
    if (strcmp(txt, last) != 0 || col != last_col) {
        lv_label_set_text(s_alarm_label, txt);
        lv_obj_set_style_text_color(s_alarm_label, lv_color_hex(col), 0);
        strcpy(last, txt);
        last_col = col;
    }
}

static void tick_cb(lv_timer_t *t)
{
    static int tick;
    tick++;

    time_t now = time(NULL);
    struct tm tm;
    clock_sync_localtime(&now, &tm);

    if (!clock_sync_time_valid()) {
        lv_label_set_text(s_time_label, "--:--");
        lv_label_set_text(s_hh_label, "--");
        lv_label_set_text(s_m10_label, "-");
        lv_label_set_text(s_m1_label, "-");
        lv_label_set_text(s_secs_label, "");
        lv_label_set_text(s_date_label, "waiting for time sync");
    } else {
        lv_label_set_text_fmt(s_time_label, "%02d:%02d", tm.tm_hour, tm.tm_min);
        lv_label_set_text_fmt(s_hh_label, "%02d", tm.tm_hour);
        lv_label_set_text_fmt(s_m10_label, "%d", tm.tm_min / 10);
        lv_label_set_text_fmt(s_m1_label, "%d", tm.tm_min % 10);
        lv_label_set_text_fmt(s_secs_label, "%02d", tm.tm_sec);
        update_date(&tm);
    }

    update_alarm_label(now);
    update_indicators(tick);
}

/* A tap on the clock background acknowledges a missed-alarm marker. Buttons
 * and the top-row widgets take their own clicks, so this only sees the
 * empty areas and the (non-clickable) labels. */
static void screen_click_cb(lv_event_t *e)
{
    if (lv_event_get_target(e) == lv_event_get_current_target(e)) {
        alarm_ack_missed();
    }
}

static void status_clear_cb(lv_timer_t *t)
{
    lv_label_set_text(s_status_label, "");
    lv_timer_pause(t);
}

void ui_clock_create(void)
{
    lv_obj_t *scr = lv_screen_active();
    lv_obj_set_style_bg_color(scr, lv_color_hex(0x000000), 0);
    lv_obj_set_style_bg_opa(scr, LV_OPA_COVER, 0);
    lv_obj_clear_flag(scr, LV_OBJ_FLAG_SCROLLABLE);
    lv_obj_add_event_cb(scr, screen_click_cb, LV_EVENT_CLICKED, NULL);

    s_cog  = round_button(scr, LV_SYMBOL_SETTINGS, cog_cb);
    s_play = round_button(scr, LV_SYMBOL_PLAY, play_cb);

    /* big HH:MM - montserrat_48 transform-scaled; face layout applied below */
    s_time_label = lv_label_create(scr);
    lv_label_set_text(s_time_label, "--:--");
    lv_obj_set_style_text_font(s_time_label, &lv_font_montserrat_48, 0);
    lv_obj_set_style_text_color(s_time_label, lv_color_hex(TIME_COL_DAY), 0);
    lv_obj_set_style_transform_pivot_x(s_time_label, lv_pct(50), 0);
    lv_obj_set_style_transform_pivot_y(s_time_label, lv_pct(50), 0);

    /* Giant face: hours, colon, stacked minute digits (native-size fonts) */
    s_hh_label = lv_label_create(scr);
    lv_label_set_text(s_hh_label, "--");
    lv_obj_set_style_text_font(s_hh_label, FONT_HH, 0);
    lv_obj_set_style_text_color(s_hh_label, lv_color_hex(TIME_COL_DAY), 0);
    lv_obj_set_style_text_align(s_hh_label, LV_TEXT_ALIGN_RIGHT, 0);
    s_colon_label = lv_label_create(scr);
    lv_label_set_text(s_colon_label, ":");
    lv_obj_set_style_text_font(s_colon_label, FONT_MM, 0);
    lv_obj_set_style_text_color(s_colon_label, lv_color_hex(TIME_COL_DAY), 0);
    s_m10_label = lv_label_create(scr);
    lv_label_set_text(s_m10_label, "-");
    lv_obj_set_style_text_font(s_m10_label, FONT_MM, 0);
    lv_obj_set_style_text_color(s_m10_label, lv_color_hex(TIME_COL_DAY), 0);
    lv_obj_set_style_text_align(s_m10_label, LV_TEXT_ALIGN_CENTER, 0);
    s_m1_label = lv_label_create(scr);
    lv_label_set_text(s_m1_label, "-");
    lv_obj_set_style_text_font(s_m1_label, FONT_MM, 0);
    lv_obj_set_style_text_color(s_m1_label, lv_color_hex(TIME_COL_DAY), 0);
    lv_obj_set_style_text_align(s_m1_label, LV_TEXT_ALIGN_CENTER, 0);

    /* seconds, small */
    s_secs_label = lv_label_create(scr);
    lv_label_set_text(s_secs_label, "");
    lv_obj_set_style_text_font(s_secs_label, &lv_font_montserrat_28, 0);
    lv_obj_set_style_text_color(s_secs_label, lv_color_hex(0x5A626C), 0);

    s_date_label = lv_label_create(scr);
    lv_label_set_text(s_date_label, "");
    lv_label_set_long_mode(s_date_label, LV_LABEL_LONG_DOT);
    lv_obj_set_style_text_font(s_date_label, &lv_font_montserrat_20, 0);
    lv_obj_set_style_text_color(s_date_label, lv_color_hex(0x9AA2AC), 0);

    s_alarm_label = lv_label_create(scr);
    lv_label_set_text(s_alarm_label, LV_SYMBOL_BELL "  off");

    /* Service indicators, coloured every tick from <mod>_service_state().
     * The music server keeps its note glyph; the other three are short words
     * rather than symbols, which the built font set has no unambiguous
     * glyphs for. Order here must match the SVC_* enum. */
    static const struct {
        const char *text;
        const lv_font_t *font;
    } SVC_DEF[SVC_COUNT] = {
        [SVC_MUSIC] = { LV_SYMBOL_AUDIO, &lv_font_montserrat_28 },
        [SVC_AI]    = { ICON_CHIP,       &app_icons_28 },
        [SVC_VOICE] = { ICON_MIC,        &app_icons_28 },
        [SVC_API]   = { "API",           SVC_FONT },
    };
    for (int i = 0; i < SVC_COUNT; i++) {
        s_svc[i] = lv_label_create(scr);
        lv_label_set_text(s_svc[i], SVC_DEF[i].text);
        lv_obj_set_style_text_font(s_svc[i], SVC_DEF[i].font, 0);
        lv_obj_set_style_text_color(s_svc[i], lv_color_hex(COL_UNLIT), 0);
    }

    /* WiFi strength: four rising bars, lit count from RSSI */
    s_wifi_box = lv_obj_create(scr);
    lv_obj_set_size(s_wifi_box, WIFI_BOX_W, WIFI_BOX_H);
    lv_obj_set_style_bg_opa(s_wifi_box, LV_OPA_TRANSP, 0);
    lv_obj_set_style_border_width(s_wifi_box, 0, 0);
    lv_obj_set_style_pad_all(s_wifi_box, 0, 0);
    lv_obj_clear_flag(s_wifi_box, LV_OBJ_FLAG_SCROLLABLE | LV_OBJ_FLAG_CLICKABLE);
    for (int i = 0; i < WIFI_BARS; i++) {
        lv_obj_t *bar = lv_obj_create(s_wifi_box);
        int32_t h = WIFI_BOX_H - (WIFI_BARS - 1 - i) * 6;
        lv_obj_set_size(bar, WIFI_BAR_W, h);
        lv_obj_set_style_radius(bar, 1, 0);
        lv_obj_set_style_border_width(bar, 0, 0);
        lv_obj_set_style_bg_color(bar, lv_color_hex(COL_UNLIT), 0);
        lv_obj_clear_flag(bar, LV_OBJ_FLAG_SCROLLABLE | LV_OBJ_FLAG_CLICKABLE);
        lv_obj_align(bar, LV_ALIGN_BOTTOM_LEFT, i * (WIFI_BAR_W + WIFI_BAR_GAP), 0);
        s_wifi_bar[i] = bar;
    }

    s_status_label = lv_label_create(scr);
    lv_label_set_text(s_status_label, "Starting...");
    lv_label_set_long_mode(s_status_label, LV_LABEL_LONG_DOT);
    lv_obj_set_width(s_status_label, lv_pct(94));
    lv_obj_set_style_text_align(s_status_label, LV_TEXT_ALIGN_CENTER, 0);
    lv_obj_set_style_text_font(s_status_label, &app_font_16, 0);
    lv_obj_set_style_text_color(s_status_label, lv_color_hex(0x5A626C), 0);
    s_status_timer = lv_timer_create(status_clear_cb, STATUS_HOLD_MS, NULL);

    /* keep the buttons above the giant digits */
    lv_obj_move_foreground(s_cog);
    lv_obj_move_foreground(s_play);

    ui_clock_apply_face();
    lv_timer_create(tick_cb, 1000, NULL);
}

void ui_clock_set_dim_level(int pct)
{
    /* Blend the digit colour across the configured brightness range: white
     * at bright_max, deep red-orange at bright_min (less light, kinder to
     * night vision). Called from the ambient task; the recursive LVGL lock
     * makes it safe from anywhere. */
    const bedside_settings_t *cfg = settings_get();
    int lo = cfg->bright_min;
    int hi = cfg->bright_max;
    int t = (hi <= lo) ? ((pct >= hi) ? 255 : 0)
                       : ((pct - lo) * 255) / (hi - lo);
    if (t < 0) {
        t = 0;
    } else if (t > 255) {
        t = 255;
    }

    uint32_t r = (((TIME_COL_NIGHT >> 16) & 0xFF) * (255 - t) + ((TIME_COL_DAY >> 16) & 0xFF) * t) / 255;
    uint32_t g = (((TIME_COL_NIGHT >> 8) & 0xFF) * (255 - t) + ((TIME_COL_DAY >> 8) & 0xFF) * t) / 255;
    uint32_t b = ((TIME_COL_NIGHT & 0xFF) * (255 - t) + (TIME_COL_DAY & 0xFF) * t) / 255;
    uint32_t rgb = (r << 16) | (g << 8) | b;

    static uint32_t s_last_rgb = TIME_COL_DAY;   /* create-time colour */
    if (rgb == s_last_rgb || s_time_label == NULL || !app_display_ready()) {
        return;
    }
    if (bsp_display_lock(1000)) {
        lv_color_t c = lv_color_hex(rgb);
        lv_obj_set_style_text_color(s_time_label, c, 0);
        lv_obj_set_style_text_color(s_hh_label, c, 0);
        lv_obj_set_style_text_color(s_colon_label, c, 0);
        lv_obj_set_style_text_color(s_m10_label, c, 0);
        lv_obj_set_style_text_color(s_m1_label, c, 0);
        bsp_display_unlock();
        s_last_rgb = rgb;   /* only cache on success so a timeout retries */
    }
}

void ui_set_status(const char *fmt, ...)
{
    char line[128];
    va_list ap;
    va_start(ap, fmt);
    vsnprintf(line, sizeof(line), fmt, ap);
    va_end(ap);

    ESP_LOGI(TAG, "status: %s", line);
    if (s_status_label != NULL && app_display_ready() && bsp_display_lock(1000)) {
        lv_label_set_text(s_status_label, line);
        /* temporary: restart the self-clear countdown */
        lv_timer_reset(s_status_timer);
        lv_timer_resume(s_status_timer);
        bsp_display_unlock();
    }
}
